## build/boards/cv181x/cv1813h_milkv_duos_ota_sd/u-boot/cvitek_cv1813h_milkv_duos_ota_sd_defconfig
```kconfig
CONFIG_RISCV=y
CONFIG_SYS_MALLOC_F_LEN=0x2000
CONFIG_NR_DRAM_BANKS=1
CONFIG_DM_GPIO=y
CONFIG_DEFAULT_DEVICE_TREE="cv181x_asic"
CONFIG_IDENT_STRING=" cvitek_cv181x"
CONFIG_ARCH_RV64I=y
CONFIG_RISCV_SMODE=y
CONFIG_TARGET_CVITEK_CV181X=y
CONFIG_DISTRO_DEFAULTS=y
CONFIG_FIT=y
CONFIG_BOOTDELAY=5
CONFIG_SYS_PROMPT="cv181x_c906# "

#CONFIG_ENV_SUPPORT=y
#CONFIG_SAVEENV=y
CONFIG_BOARD_LATE_INIT=n

CONFIG_ENV_IS_IN_EXT4=y
CONFIG_ENV_EXT4_DEVICE_AND_PART="0:2"
CONFIG_ENV_EXT4_FILE="/uboot.env"
CONFIG_ENV_EXT4_INTERFACE="mmc"
CONFIG_EXT4_WRITE=y
CONFIG_ENV_SIZE=0x4000

CONFIG_PARTITION_TYPE_GUID=y

#CONFIG_USE_BOOTCOMMAND=y
#CONFIG_BOOTCOMMAND="saveenv;"

#CONFIG_ENV_IS_IN_MMC=y
#CONFIG_SYS_MMC_ENV_DEV=0
#CONFIG_SYS_MMC_ENV_PART=2
#CONFIG_ENV_OFFSET=0
#CONFIG_ENV_SIZE=0x40000
#CONFIG_ENV_SECT_SIZE=0x20000

#CONFIG_ENV_IS_IN_FAT=y
#CONFIG_ENV_FAT_INTERFACE="mmc"
#CONFIG_ENV_FAT_DEVICE_AND_PART="0:1"
#CONFIG_ENV_SIZE=0x2000
#CONFIG_SYS_REDUNDAND_ENVIRONMENT=n

#CONFIG_FS_FAT=y
CONFIG_FAT_WRITE=y
#CONFIG_SYS_CONSOLE_ENV_OVERWRITE=y
#CONFIG_SYS_CONSOLE_IS_IN_ENV=n
#CONFIG_SPECIFY_CONSOLE_INDEX=n


CONFIG_CMD_GPIO=y
CONFIG_CMD_MMC=y
CONFIG_CMD_CACHE=y
CONFIG_CMD_CVI_VO=y

CONFIG_NET_RANDOM_ETHADDR=y
CONFIG_DWAPB_GPIO=y
CONFIG_MMC=y
CONFIG_MMC_SDHCI=y
CONFIG_MMC_SDHCI_SDMA=y
CONFIG_MMC_SDHCI_CVITEK=y
CONFIG_MTD=y
CONFIG_PHY_CVITEK=y
CONFIG_DM_ETH=y
CONFIG_ETH_DESIGNWARE=y
CONFIG_SYS_NS16550=y
CONFIG_SPI=y
CONFIG_DM_VIDEO=y
CONFIG_BMP_16BPP=y
CONFIG_BMP_24BPP=y
CONFIG_BMP_32BPP=y
CONFIG_LZ4=y
CONFIG_LZMA=y
# CONFIG_TOOLS_LIBCRYPTO is not set
```

## buildroot-2021.05/package/duo-pinmux/Config.in
```kconfig
config BR2_PACKAGE_DUO_PINMUX
	bool "Duo pinmux"
	help
	  Milk-V Duo Pin Multiplexing.

if BR2_PACKAGE_DUO_PINMUX

choice
	prompt "Duo pin multiplexing"
	default BR2_PACKAGE_DUO_PINMUX_DUO

config BR2_PACKAGE_DUO_PINMUX_DUO
	bool "Duo"
	help
	  pinmux for duo.

config BR2_PACKAGE_DUO_PINMUX_DUO256M
	bool "Duo256M"
	help
	  pinmux for duo256m.

config BR2_PACKAGE_DUO_PINMUX_DUOS
	bool "Duo256M"
	help
	  pinmux for duo256m.

endchoice

endif
```

## buildroot-2021.05/package/duo-wiringx/Config.in
```kconfig
config BR2_PACKAGE_DUO_WIRINGX
	bool "wiringX"
	help
	  wiringX for Milk-V Duo

	  https://github.com/milkv-duo/duo-wiringx
```
